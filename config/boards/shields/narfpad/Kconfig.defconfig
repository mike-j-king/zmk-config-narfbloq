## config/boards/shields/narfpad/Kconfig.defconfig
```kconfig
# Copyright (c) 2020 The ZMK Contributors
# SPDX-License-Identifier: MIT

if SHIELD_NARFPAD

config ZMK_KEYBOARD_NAME
    default "narfpad"

endif
```
